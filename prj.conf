## CMakeLists.txt
```
#
# Copyright (c) 2021 Lab5e AS
#

cmake_minimum_required(VERSION 3.13.1)

find_package(Zephyr REQUIRED HINTS $ENV{ZEPHYR_BASE})
project(CozIR)

target_sources(app PRIVATE src/main.c)
target_sources(app PRIVATE src/cozir.c)
target_sources(app PRIVATE src/modeminfo.c)
target_sources(app PRIVATE src/message.c)
```

## prj.conf
```kconfig
# Segger RTT

CONFIG_BSD_LIBRARY=y
CONFIG_GPIO=n
CONFIG_SERIAL=y
CONFIG_STDOUT_CONSOLE=y
CONFIG_UART_INTERRUPT_DRIVEN=y
CONFIG_NETWORKING=y
CONFIG_NET_BUF_USER_DATA_SIZE=1
CONFIG_NET_SOCKETS_OFFLOAD=y
CONFIG_NET_SOCKETS=y
CONFIG_NET_SOCKETS_POSIX_NAMES=y
CONFIG_TRUSTED_EXECUTION_NONSECURE=y
CONFIG_LOG=n
CONFIG_MAIN_STACK_SIZE=8192
CONFIG_HEAP_MEM_POOL_SIZE=2048

CONFIG_LTE_LINK_CONTROL=y
CONFIG_LTE_NETWORK_MODE_LTE_M=y
CONFIG_LTE_AUTO_INIT_AND_CONNECT=n
CONFIG_LTE_PDP_CMD=y
CONFIG_LTE_PDP_CONTEXT="0,\"IP\",\"mda.lab5e\""
CONFIG_MODEM_INFO=y

CONFIG_BOOTLOADER_MCUBOOT=y

CONFIG_I2C=y
CONFIG_I2C_NRFX=y
# Discouraged style, I know. Bite me.
CONFIG_I2C_1=y
```

## src/main.c
```c
/*
	Copyright [2019] [Exploratory Engineering]
	Modifications Copyright [2021] [Lab5e AS]

    Licensed under the Apache License, Version 2.0 (the "License");
    you may not use this file except in compliance with the License.
    You may obtain a copy of the License at

        http://www.apache.org/licenses/LICENSE-2.0

    Unless required by applicable law or agreed to in writing, software
    distributed under the License is distributed on an "AS IS" BASIS,
    WITHOUT WARRANTIES OR CONDITIONS OF ANY KIND, either express or implied.
    See the License for the specific language governing permissions and
    limitations under the License.#include <zephyr.h>
*/   

#include <zephyr.h>
#include <errno.h>
#include <stdio.h>
#include "cozir.h"
#include "modeminfo.h"
#include <modem/lte_lc.h>
#include "message.h"


// If you haven't already registered your device in Span, you should undefine this
// and connect a terminal emulator before running the sample. 
// The IMEI and IMSI numbers will then be displayed on the console. Copy and use
// these numbers in the "Add new device" dialog in Span.
#define MODULE_IS_ALREADY_REGISTERED_IN_SPAN 1

void main() 
{
	printk("Feather CozIR sample started\n"); 

#if !(MODULE_IS_ALREADY_REGISTERED_IN_SPAN)
	get_modem_info();
#endif

	// Initialize and configure the modem
    int err = lte_lc_init();
    if (err != 0) {
        printk("lte_lc_init failed: %d\n", err);
        return;
    }

	// Initialize and configure the modem
	printk("Connecting to mda.lab5e...\n"); 
	err = lte_lc_connect();
	if (err != 0) 
	{
		printk("lte_lc_connect failed: %d\n", err);
		return;
	}

	// Initialize I2C and the CozIR sensor
    init_CozIR();

    uint16_t ppm;
    int seconds = 0;
    char messagebuffer[32];
    while (true)
    {
        k_sleep(K_SECONDS(1));
        seconds++;

		// Get the CO2 concentration from the sensor in parts per million
        read_CozIR_CO2_PPM(&ppm);
        printk("PPM CO2: %d\n", ppm);

		// Transmit every ten seconds. If you are on a limited data subscription plan, 
		// you may want to increase this delay :)
        if (seconds % 10 == 0)
        {
			// For the sake of clarity, we'll encode a text string. In a real world
			// application you would want to send the raw binary value instead and
			// decode this where you want to access the data.
            sprintf(messagebuffer, "CO2: %d ppm", ppm);
        	if (send_message(messagebuffer)) 
            {
        		printk("Message sent ok!\n"); 
	        } else {
		        printk("Failed to send message\n");
            }
        }
    }
}
```

## src/cozir.c
```c
/*
    Copyright [2021] [Lab5e AS]

    Licensed under the Apache License, Version 2.0 (the "License");
    you may not use this file except in compliance with the License.
    You may obtain a copy of the License at

        http://www.apache.org/licenses/LICENSE-2.0

    Unless required by applicable law or agreed to in writing, software
    distributed under the License is distributed on an "AS IS" BASIS,
    WITHOUT WARRANTIES OR CONDITIONS OF ANY KIND, either express or implied.
    See the License for the specific language governing permissions and
    limitations under the License.#include <zephyr.h>
*/   

#include "cozir.h"
#include <zephyr.h>
#include <device.h>
#include <drivers/i2c.h>

const struct device * i2c_device;

#define I2C_DEV "I2C_1"

int init_CozIR()
{
    i2c_device = device_get_binding(I2C_DEV);
    if (!i2c_device) 
    {
        printk("I2C: Device driver not found.\n");
        return -1;
    }
    printk("I2C: Device driver OK.\n");

    int ret = i2c_configure(i2c_device, I2C_SPEED_SET(I2C_SPEED_STANDARD));
    if (ret < 0 )
    {
        printk("I2C Configuration failed\n");
        return ret;
    }
    return 0;
}

int read_CozIR_CO2_PPM(uint16_t * ppm)
{
    uint8_t co2_ppm[2] = {0,0};
    int ret = i2c_burst_read(i2c_device, COZIR_I2C_ADDRESS, COZIR_CO2_LEVEL_REGISTER, &co2_ppm[0], 2);
    if (ret == 0)
    {
        *ppm = co2_ppm[0] << 8 | co2_ppm[1]; 
    }
    else
    {
        printk("i2c_burst_read failed with error: %d\n", ret);
    }
    return ret;
}
```

## src/cozir.h
```c
/*
    Copyright [2021] [Lab5e AS]

    Licensed under the Apache License, Version 2.0 (the "License");
    you may not use this file except in compliance with the License.
    You may obtain a copy of the License at

        http://www.apache.org/licenses/LICENSE-2.0

    Unless required by applicable law or agreed to in writing, software
    distributed under the License is distributed on an "AS IS" BASIS,
    WITHOUT WARRANTIES OR CONDITIONS OF ANY KIND, either express or implied.
    See the License for the specific language governing permissions and
    limitations under the License.#include <zephyr.h>
*/   

#pragma once

#include <stdint.h>

#define COZIR_I2C_ADDRESS 0x41

#define COZIR_CO2_LEVEL_REGISTER            0x02   
#define COZIR_SENSOR_CONTROL_SETTINGS       0x05  
#define COZIR_AUTO_ZERO_TARGET              0x0C
#define COZIR_TARGET_VALUE_CO2_FRESH_AIR    0x12
#define COZIR_KNOWN_CO2                     0x14
#define COZIR_AUTO_ZERO_CYCLES              0x1A
#define COZIR_SERIAL_NUMBER_REGISTER        0x26
#define COZIR_NPULSE                        0x2A
#define COZIR_AUTO_ZERO_CONTROL             0x4E
#define COZIR_ALTITUDE_PRESSURE             0x76

int init_CozIR();
int read_CozIR_CO2_PPM(uint16_t * ppm);
```

## src/message.c
```c
/*
    Copyright [2019] [Exploratory Engineering]
	Modifications Copyright [2021] [Lab5e AS]

    Licensed under the Apache License, Version 2.0 (the "License");
    you may not use this file except in compliance with the License.
    You may obtain a copy of the License at

        http://www.apache.org/licenses/LICENSE-2.0

    Unless required by applicable law or agreed to in writing, software
    distributed under the License is distributed on an "AS IS" BASIS,
    WITHOUT WARRANTIES OR CONDITIONS OF ANY KIND, either express or implied.
    See the License for the specific language governing permissions and
    limitations under the License.#include <zephyr.h>
*/   

#include <net/socket.h>

bool send_message(const char *message) 
{
	int sock = socket(AF_INET, SOCK_DGRAM, IPPROTO_UDP);
	if (sock < 0) 
	{
		printk("Error opening socket: %d\n", errno);
		return false;
	}

	static struct sockaddr_in remote_addr = 
	{
		sin_family: AF_INET,
		sin_port:   htons(1234),
	};
	net_addr_pton(AF_INET, "172.16.15.14", &remote_addr.sin_addr);

	if (sendto(sock, message, strlen(message), 0, (struct sockaddr *)&remote_addr, sizeof(remote_addr)) < 0) 
	{
		printk("Error sending: %d\n", errno);
		close(sock);
		return false;
	}

	close(sock);
	return true;
}
```

## src/message.h
```c
/*
    Copyright [2021] [Lab5e AS]

    Licensed under the Apache License, Version 2.0 (the "License");
    you may not use this file except in compliance with the License.
    You may obtain a copy of the License at

        http://www.apache.org/licenses/LICENSE-2.0

    Unless required by applicable law or agreed to in writing, software
    distributed under the License is distributed on an "AS IS" BASIS,
    WITHOUT WARRANTIES OR CONDITIONS OF ANY KIND, either express or implied.
    See the License for the specific language governing permissions and
    limitations under the License.#include <zephyr.h>
*/   

#pragma once

bool send_message(const char *message);
```

## src/modeminfo.c
```c
/*
    Copyright [2019] [Exploratory Engineering]
	Modifications Copyright [2021] [Lab5e AS]

    Licensed under the Apache License, Version 2.0 (the "License");
    you may not use this file except in compliance with the License.
    You may obtain a copy of the License at

        http://www.apache.org/licenses/LICENSE-2.0

    Unless required by applicable law or agreed to in writing, software
    distributed under the License is distributed on an "AS IS" BASIS,
    WITHOUT WARRANTIES OR CONDITIONS OF ANY KIND, either express or implied.
    See the License for the specific language governing permissions and
    limitations under the License.#include <zephyr.h>
*/   

#include <zephyr.h>
#include <stdio.h>
#include <string.h>
#include <stdint.h>
#include "modeminfo.h"
#include <modem/lte_lc.h>
#include <modem/modem_info.h>

#define MODEM_INFO_BUFFER_SIZE 32
uint8_t modem_info_buf[MODEM_INFO_BUFFER_SIZE];

bool get_modem_info() 
{
	// Initialize the modem information module
	if (modem_info_init() != 0) 
	{
		printk("Modem info could not be initialized");
		return false;
	}

	// Configure the modem for normal operation mode
	int ret = lte_lc_normal();
	if (ret != 0) 
	{
		printk("lte_lc_normal: %d\n", ret);
		return false;
	}

	// Wait until the SIM card is ready
	while (true) 
	{
		uint16_t uicc_state;
		int len = modem_info_short_get(MODEM_INFO_UICC, &uicc_state);
		if (len <= 0) 
		{
			printk("Failed reading UICC: %d\n", len);
			return false;
		}
		if (uicc_state == 1) 
		{
			break;
		}
		k_sleep(K_SECONDS(1));
	}

	// Retrieve the 15 digit IMEI (required for registering your device in Span)
	memset(modem_info_buf, 0, MODEM_INFO_BUFFER_SIZE);
	int len = modem_info_string_get(MODEM_INFO_IMEI, modem_info_buf, MODEM_INFO_BUFFER_SIZE);
	if (len <= 0) 
	{
		printk("Failed reading IMEI: %d\n", len);
		return false;
	}
	printk("IMEI: %s\n", modem_info_buf);

	// Retrieve the 15 digit IMSI (required for registering your device in Span)
	len = modem_info_string_get(MODEM_INFO_IMSI, modem_info_buf, MODEM_INFO_BUFFER_SIZE);
	if (len <= 0) 
	{
		printk("Failed reading IMSI: %d\n", len);
		return false;
	}
	printk("IMSI: %s\n", modem_info_buf);

	// Put the modem offline
	ret = lte_lc_offline();
	if (ret != 0) 
	{
		printk("lte_lc_offline: %d\n", ret);
		return false;
	}

	return true;
}
```

## src/modeminfo.h
```c
/*
    Copyright [2021] [Lab5e AS]

    Licensed under the Apache License, Version 2.0 (the "License");
    you may not use this file except in compliance with the License.
    You may obtain a copy of the License at

        http://www.apache.org/licenses/LICENSE-2.0

    Unless required by applicable law or agreed to in writing, software
    distributed under the License is distributed on an "AS IS" BASIS,
    WITHOUT WARRANTIES OR CONDITIONS OF ANY KIND, either express or implied.
    See the License for the specific language governing permissions and
    limitations under the License.#include <zephyr.h>
*/   

#pragma once

bool get_modem_info();
```
